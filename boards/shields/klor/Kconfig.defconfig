## boards/shields/klor/Kconfig.defconfig
```kconfig
if SHIELD_KLOR_DONGLE

    config ZMK_KEYBOARD_NAME
        default "KLOR"

    config ZMK_SPLIT_BLE_ROLE_CENTRAL
        default y

    config ZMK_USB
        default y

endif

if SHIELD_KLOR_DONGLE || SHIELD_KLOR_LEFT || SHIELD_KLOR_RIGHT

    config ZMK_SPLIT
        default y

endif
```
